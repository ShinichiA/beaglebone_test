
// ----------------------- I2C ---------------------------------------------------

&am33xx_pinmux {
    i2c1_pin: i2c1_pin {
        pinctrl-single,pins = <
			AM33XX_PADCONF(AM335X_PIN_SPI0_CS0, PIN_INPUT_PULLUP, MUX_MODE2)
			AM33XX_PADCONF(AM335X_PIN_SPI0_D1, PIN_INPUT_PULLUP, MUX_MODE2)
        >;
    };
};

&i2c1 {
    pinctrl-names = "default";
    pinctrl-0 = <&i2c1_pin>;
	clock_frequency = <100000>;
    status = "okay";

	ssd1306@3c {
		compatible = "solomon,ssd1306";
		reg = <0x3c>;
	};
};
